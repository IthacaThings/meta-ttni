## conf/layer.conf
```bitbake
# We have a conf and classes directory, add to BBPATH
BBPATH .= ":${LAYERDIR}"

# We have recipes-* directories, add to BBFILES
BBFILES += "${LAYERDIR}/recipes-*/*/*.bb \
	${LAYERDIR}/recipes-*/*/*.bbappend"

BBFILE_COLLECTIONS += "meta-ttni"
BBFILE_PATTERN_meta-ttni = "^${LAYERDIR}/"
BBFILE_PRIORITY_meta-ttni = "100"

LAYERSERIES_COMPAT_meta-ttni = "thud"
```
